## CMakeLists.txt
```
# ============================================================================
# LightNMEA Zephyr benchmark - Zephyr application
# ============================================================================
# Сравнительный бенчмарк NMEA-парсеров (LightNMEA vs minmea vs TinyGPSPlus)
# в главном потоке Zephyr.
#
# Сборка (см. README.md):
#   west build -b native_sim -d build/native_sim
#   west build -b nrf52840dk/nrf52840 -d build/nrf52840dk
# ============================================================================

cmake_minimum_required(VERSION 3.20.0)
find_package(Zephyr REQUIRED HINTS $ENV{ZEPHYR_BASE})
project(gps_nmea_bench)

# Vendored копии конкурентов из benchmarks/firmware/lib (синхронны с
# benchmarks/compare/third_party)
set(TP ${CMAKE_CURRENT_SOURCE_DIR}/../../firmware/lib)

target_sources(app PRIVATE
  src/main.cpp
  ${TP}/minmea/src/minmea.c
  ${TP}/TinyGPSPlus/src/TinyGPS++.cpp
)

# Ядро LightNMEA (header-only, не зависит от Arduino/POSIX) + конкуренты
target_include_directories(app PRIVATE
  ${CMAKE_CURRENT_SOURCE_DIR}/../../../include
  ${TP}/minmea/include
  ${TP}/TinyGPSPlus/include
  ${CMAKE_CURRENT_SOURCE_DIR}/..   # Arduino.h shim
)

# TinyGPS++.cpp не должен определять свою chrono-версию millis()
# (иначе - конфликт символов с RTOS-версией бенча).
set_source_files_properties(${TP}/TinyGPSPlus/src/TinyGPS++.cpp PROPERTIES
    COMPILE_DEFINITIONS "ARDUINO=1")

# picolibc не имеет timegm(); mktime эквивалентен (TZ на плате = UTC),
# как в firmware-бенчмарке (platformio.ini: -Dtimegm=mktime).
set_source_files_properties(${TP}/minmea/src/minmea.c PROPERTIES
    COMPILE_DEFINITIONS "timegm=mktime")

# nRF52840: системный таймер - RTC 32.768 кГц, поэтому
# CONFIG_SYS_CLOCK_HW_CYCLES_PER_SEC даёт mhz=0 и метрики cycles/pkt
# обнуляются. Поэтому для CPU-циклов задаю частоту ядра явно (как в firmware-бенчмарке).
if(CONFIG_SOC_NRF52840)
  target_compile_definitions(app PRIVATE F_CPU=64000000)
endif()
```

## prj.conf
```kconfig
# LightNMEA Zephyr benchmark - project configuration
#
# C++ поддержка: полная libstdc++ нужна для std::string_view, std::array,
# std::mt19937 (nav_gen.hpp) и C++ runtime (operator delete).

CONFIG_CPP=y
CONFIG_STD_CPP17=y
CONFIG_REQUIRES_FULL_LIBCPP=y

# nav_gen.hpp использует thread_local (std::mt19937 в get_nav_packet()).
# На ARM (nrf52840) без TLS-поддержки ядра это не линкуется.
CONFIG_THREAD_LOCAL_STORAGE=y

# Основной стек: TinyGPSPlus (~200 Б) + Parser + minmea-структуры + printk.
CONFIG_MAIN_STACK_SIZE=8192
```

## src/main.cpp
```c
/*
 * LightNMEA - Ultra-fast NMEA GPS parser
 * Copyright (C) 2026 Roman Shevchik
 *
 * This program is free software: you can redistribute it and/or modify
 * it under the terms of the GNU General Public License as published by
 * the Free Software Foundation, either version 3 of the License, or
 * (at your option) any later version.
 *
 * This program is distributed in the hope that it will be useful,
 * but WITHOUT ANY WARRANTY; without even the implied warranty of
 * MERCHANTABILITY or FITNESS FOR A PARTICULAR PURPOSE.  See the
 * GNU General Public License for more details.
 *
 * You should have received a copy of the GNU General Public License
 * along with this program.  If not, see <https://www.gnu.org/licenses/>.
 */

/**
 * @file main.cpp
 * @brief Zephyr-обёртка сравнительного бенчмарка NMEA-парсеров.
 *
 * Запускает bench_rtos::run_benchmark() в главном потоке Zephyr.
 * Источник времени - k_cycle_get_32() + k_cyc_to_us_ceil32() (аппаратный
 * цикловой счётчик; на native_sim - симулированный).
 *
 * F_CPU для метрики cycles/pkt: по умолчанию частота циклового счётчика
 * Zephyr (CONFIG_SYS_CLOCK_HW_CYCLES_PER_SEC). Частоту CPU для конкретной
 * платы задайте с помощью F_CPU CMake (см. CMakeLists.txt: nRF52840 -> 64 МГц).
 *
 * Сборка (см. README.md):
 *   west build -b native_sim -d build/native_sim
 *   west build -b nrf52840dk/nrf52840 -d build/nrf52840dk
 */

#include <zephyr/kernel.h>
#include <zephyr/sys/printk.h>

#include <cstdarg>

#ifndef F_CPU
#define F_CPU CONFIG_SYS_CLOCK_HW_CYCLES_PER_SEC
#endif

#include "bench_compare_rtos.hpp"

// ============================================================================
// millis() для TinyGPSPlus (объявлена в Arduino.h-обёртке)
// ============================================================================
unsigned long millis() {
  return static_cast<unsigned long>(k_uptime_get_32());
}

// ============================================================================
// Источник времени в микросекундах (цикловой счётчик Zephyr)
// ============================================================================
static uint64_t now_us() {
  return static_cast<uint64_t>(k_cyc_to_us_ceil32(k_cycle_get_32()));
}

// ============================================================================
// printf-совместимый вывод поверх printk (printk возвращает void)
// ============================================================================
static int printk_adapter(const char *fmt, ...) {
  va_list ap;
  va_start(ap, fmt);
  vprintk(fmt, ap);
  va_end(ap);
  return 0;
}

// ============================================================================
// main
// ============================================================================
int main(void) {
  const bench_rtos::BenchEnv env{now_us, printk_adapter};
  bench_rtos::run_benchmark(env);
  return 0;
}
```
