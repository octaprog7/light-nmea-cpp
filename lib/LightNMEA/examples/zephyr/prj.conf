## CMakeLists.txt
```
# ============================================================================
# LightNMEA Zephyr example - Zephyr application
# ============================================================================
# Приложение Zephyr, которое читает поток NMEA из UART с помощью API uart_pipe
# и парсит их библиотекой LightNMEA (NMEAStreamReader + Parser).
#
# Сборка (см. README.md):
#   west build -b native_sim -d build/native_sim
#   west build -b nrf52840dk/nrf52840 -d build/nrf52840dk
# ============================================================================

cmake_minimum_required(VERSION 3.20.0)
find_package(Zephyr REQUIRED HINTS $ENV{ZEPHYR_BASE})
project(gps_nmea)

target_sources(app PRIVATE src/main.cpp)

# Ядро LightNMEA (header-only, не зависит от Arduino/POSIX)
target_include_directories(app PRIVATE ${CMAKE_CURRENT_SOURCE_DIR}/../../include)
```

## west.yml
```
# ============================================================================
# LightNMEA Zephyr example - west manifest
# ============================================================================
# Defines the Zephyr version used to build the example:
#   west init -l .
#   west update
#   west build -b native_sim -d build/native_sim
# ============================================================================

manifest:
  # ВАЖНО: поле remote проекта - это ИМЯ remote из секции remotes,
  # а не URL. Прямой URL в remote даёт
  # "Malformed manifest file: project zephyr remote <url> is not defined".
  remotes:
    - name: zephyrproject
      url-base: https://github.com/zephyrproject-rtos
  projects:
    - name: zephyr
      remote: zephyrproject
      revision: v3.6.0
      import: true
      # ВАЖНО: путь клона НЕ должен совпадать с каталогом приложения.
      # west topdir = examples/, и path проекта (zephyr) по умолчанию - это
      # examples/zephyr, где лежат CMakeLists.txt и west.yml приложения:
      # git clone падает на конфликте файлов. Клонируем в deps/zephyr.
      path: deps/zephyr
  self:
    path: .
```

## prj.conf
```kconfig
# LightNMEA Zephyr example - project configuration
#
# uart_pipe: простой API для приёма потока данных из UART в обработчик.
# Устройство выбирается с помощью devicetree chosen "zephyr, uart-pipe"
# (см. boards/*.overlay).
#
# ВАЖНО: CONFIG_UART_PIPE включается НЕ здесь, а в per-board конфигах
# boards/<board>.conf (см. boards/nrf52840dk_nrf52840.conf). Причина:
# в Zephyr v3.6.0 в native_sim нет serial-драйвера, выставляющего
# SERIAL_SUPPORT_INTERRUPT, поэтому CONFIG_UART_PIPE (select
# UART_INTERRUPT_DRIVEN) роняет Kconfig ("Aborting due to Kconfig
# warnings"), а CONFIG_SERIAL без драйвера бесполезен. На платах с
# рабочим UART-драйвером (nrf52840dk и др.) uart_pipe включён и пример
# принимает NMEA-поток через boards/<board>.conf.

# Поддержка для std::string_view (substr) C++ нужна полная libstdc++ и C++ runtime (operator delete).
CONFIG_CPP=y
CONFIG_STD_CPP17=y
CONFIG_REQUIRES_FULL_LIBCPP=y
```

## boards/nrf52840dk_nrf52840.conf
```kconfig
# nrf52840dk: включаем uart_pipe (приём NMEA через UART).
# На этой плате драйвер nrfx UART выставляет SERIAL_SUPPORT_INTERRUPT,
# поэтому select-цепочка UART_PIPE -> UART_INTERRUPT_DRIVEN разрешается
# корректно (на native_sim в Zephyr 3.6 это не так — там uart_pipe не
# включается, см. комментарий в prj.conf).
CONFIG_SERIAL=y
CONFIG_UART_PIPE=y
```

## boards/native_sim.overlay
```dts
/*
 * LightNMEA Zephyr example - native_sim overlay
 *
 * На native_sim UART0 подключён к stdin/stdout: ввод NMEA-строк в терминал попадает в обработчик uart_pipe.
 */

/ {
	chosen {
		zephyr,uart-pipe = &uart0;
	};
};
```

## boards/nrf52840dk_nrf52840.overlay
```dts
/*
 * LightNMEA Zephyr example - nRF52840 DK overlay
 *
 * Использует UART0 (pins P0.06 TX / P0.08 RX) для uart_pipe.
 * Для других плат создайте свой overlay в папке boards/ и настройте
 * chosen "zephyr,uart-pipe" на нужный UART.
 */

/ {
	chosen {
		zephyr,console = &uart0;
		zephyr,uart-pipe = &uart0;
	};
};

&uart0 {
	status = "okay";
	current-speed = <115200>;
};
```

## src/main.cpp
```c
/*
 * LightNMEA Zephyr example
 *
 * Читает NMEA-данные из UART вызовом API uart_pipe, накапливает байты в
 * кольцевом буфере и парсит их в главном цикле библиотекой LightNMEA (NMEAStreamReader +
 * Parser).
 *
 * Ядро LightNMEA (light_nmea.hpp, nmea_stream_reader.hpp, nmea_formatter.hpp)
 * не зависит от Arduino/POSIX, поэтому работает в Zephyr без изменений.
 *
 * Сборка: см. README.md.
 */

#include <zephyr/device.h>
#include <zephyr/drivers/uart_pipe.h>
#include <zephyr/kernel.h>
#include <zephyr/sys/printk.h>

#include "nmea_formatter.hpp"
#include "nmea_stream_reader.hpp"

using namespace light_nmea;

// ============================================================================
// Кольцевой буфер для байт из UART (заполняется в обработчике uart_pipe)
// ============================================================================
#define RING_SIZE 512
static uint8_t ring_data[RING_SIZE];
static volatile uint16_t ring_head = 0;
static volatile uint16_t ring_tail = 0;

// ============================================================================
// Stream поверх кольцевого буфера
// ============================================================================
// NMEAStreamReader читает байты вызовом Stream::read().
class RingStream final : public Stream {
public:
  size_t read(uint8_t *buffer, size_t max_len) override {
    size_t n = 0;
    while (n < max_len && ring_head != ring_tail) {
      buffer[n++] = ring_data[ring_tail];
      ring_tail = static_cast<uint16_t>((ring_tail + 1) % RING_SIZE);
    }
    return n;
  }
};

// ============================================================================
// Обработчик uart_pipe: байты из UART -> кольцевой буфер
// ============================================================================
// Новый API uart_pipe: драйвер пишет принятые байты в буфер
// и вызывает callback(buf, &off); callback возвращает буфер для следующего
// приёма (обычно тот же) и сбрасывает off в 0.
#ifdef CONFIG_UART_PIPE
static uint8_t pipe_buffer[64];

static uint8_t *pipe_handler(uint8_t *buf, size_t *off) {
  for (size_t i = 0; i < *off; ++i) {
    const uint16_t next = static_cast<uint16_t>((ring_head + 1) % RING_SIZE);
    if (next != ring_tail) { // буфер не переполнен
      ring_data[ring_head] = buf[i];
      ring_head = next;
    }
  }
  *off = 0;
  return buf;
}
#endif // CONFIG_UART_PIPE

// ============================================================================
// Время в миллисекундах (для анти-спам фильтра NMEAStreamReader)
// ============================================================================
static uint32_t get_time_ms() { return k_uptime_get_32(); }

// ============================================================================
// main
// ============================================================================
int main(void) {
  Parser parser;
  NMEAStreamReader reader;
  RingStream stream;

#ifdef CONFIG_UART_PIPE
  uart_pipe_register(pipe_buffer, sizeof(pipe_buffer), pipe_handler);
#endif
  printk("LightNMEA Zephyr example started\n");
#ifdef CONFIG_UART_PIPE
  printk("UART pipe active: feed NMEA lines to the selected UART\n");
#else
  printk("UART pipe disabled (CONFIG_UART_PIPE=n): no input source\n");
#endif

  while (1) {
    const size_t processed = reader.read_available(parser, stream, get_time_ms);
    if (processed > 0) {
      const NMEAData &data = parser.data();
      if (data.has_coordinates()) {
        char buf[256];
        to_txt(data, buf, sizeof(buf));
        printk("%s\n", buf);
      }
    }
    k_sleep(K_MSEC(10));
  }

  return 0;
}
```
